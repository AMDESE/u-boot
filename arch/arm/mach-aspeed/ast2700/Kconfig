## drivers/crypto/aspeed/Kconfig
```kconfig
config ASPEED_HACE
	bool "ASPEED Hash and Crypto Engine"
	depends on DM_HASH
	help
	  Select this option to enable a driver for using the SHA engine in
	  the ASPEED BMC SoCs.

	  Enabling this allows the use of SHA operations in hardware without
	  requiring the SHA software implementations. It also improves performance
	  and saves code size.

config ASPEED_ACRY
	bool "ASPEED RSA and ECC Engine"
	depends on ASPEED_AST2600
	help
	 Select this option to enable a driver for using the RSA/ECC engine in
	 the ASPEED BMC SoCs.

	 Enabling this allows the use of RSA/ECC operations in hardware without requiring the
	 software implementations. It also improves performance and saves code size.

config ASPEED_RSSS
	bool "Aspeed RSSS Engine"
	depends on ASPEED_AST2700 || TARGET_ASPEED_AST2700
	help
	  Select here to enable Aspeed RSSS Engine driver.
	  Supports RSA 2048 to 4096 bits encryption/decryption and
	  signature/verification, It's a new hardware design from
          ast2700 for simply SRAM layout.

config ASPEED_CPTRA_SHA
	bool "Caliptra SHA ACC for Aspeed SoCs"
	depends on DM_HASH
	depends on TARGET_ASPEED_AST2700
	help
	  Select this option to enable a driver for using the SHA accelerator provided
	  by Caliptra, which is integrated in AST27xx BMC SoCs.

	  Enabling this allows the use of SHA operations in hardware. Note that only
	  SHA384 and SHA512 are supported by Caliptra.

config ASPEED_CPTRA_ECDSA
	bool "Caliptra ECDSA384 signature verifier for Aspeed SoCs"
	depends on SPL_ECDSA_VERIFY
	depends on TARGET_ASPEED_AST2700
	help
	  Select this option to enable a driver for using the ECDSA384_SIGNATURE_VERIFY
	  feature of Caliptra, which is integrated in AST27xx BMC SoCs.

	  Enabling this allows the use of ECDSA384 signature verification in hardware.
	  Note that only ECDSA384 is supported by Caliptra.
```

## drivers/ram/aspeed/Kconfig
```kconfig
if ASPEED_RAM

config ASPEED_FPGA
	bool "FPGA support"
	help
	  Say Y is platform is FPGA.

config ASPEED_DDR4_DUALX8
	bool "Enable Dual X8 DDR4 die"
	help
	 Say Y if dual X8 DDR4 die is used on the board. The ASPEED DDRM
	 SRAM controller needs to know if the memory chip mounted on the
	 board is dual x8 die or not, otherwise it may get the wrong
	 size of the memory space.

config ASPEED_DDR_PHY_TRAINING
	bool "Enable DDR PHY Training"
	depends on ASPEED_RAM
	help
	  Say 'y' to enable the PHY training

config ASPEED_BYPASS_SELFTEST
	depends on ASPEED_AST2600
	bool "Bypass self test during initialization"
	help
	  Say Y here to bypass DRAM self test to speed up the boot time.

choice
	prompt "AST2600 DDR4 target date rate"
	default ASPEED_DDR4_1600
	depends on ASPEED_AST2600

config ASPEED_DDR4_400
	bool "400Mbps"
	help
	  select DDR4 target data rate at 400M

config ASPEED_DDR4_800
	bool "800Mbps"
	help
	  select DDR4 target data rate at 800M

config ASPEED_DDR4_1333
	bool "1333Mbps"
	help
	  select DDR4 target data rate at 1333M

config ASPEED_DDR4_1600
	bool "1600Mbps"
	help
	  select DDR4 target data rate at 1600M

config ASPEED_DDR4_3200
	bool "3200Mbps"
	help
	  select DDR4 target data rate at 3200M
endchoice

choice
	prompt "AST2700 DDR target date rate"
	default ASPEED_DDR_1600
	depends on ASPEED_RAM
	depends on TARGET_ASPEED_AST2700

config ASPEED_DDR_1600
	bool "1600Mbps"
	help
	  select DDR4 target data rate at 1600M

config ASPEED_DDR_2400
	bool "2400Mbps"
	help
	  select DDR4 target data rate at 2400M

config ASPEED_DDR_3200
	bool "3200Mbps"
	help
	  select DDR4 target data rate at 3200M

endchoice

endif # End of ASPEED_RAM
```

## drivers/soc/aspeed/Kconfig
```kconfig
config ASPEED_OTP
	bool "ASPEED OTP(One Time Programmable) Memory Driver"
	depends on ASPEED_AST2700
	help
	  Select this option to enable a driver for using the OTP in
	  the ASPEED BMC SoCs.
	  Enabling this allows the use of OTP command utility.
```
