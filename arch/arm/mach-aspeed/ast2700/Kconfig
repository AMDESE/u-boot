## arch/arm/mach-aspeed/ast2700/Kconfig
```kconfig
if ASPEED_AST2700

config SYS_CPU
	default "armv8"

choice
	prompt "AST2700 board select"
	depends on ASPEED_AST2700
	default TARGET_EVB_AST2700

config TARGET_EVB_AST2700
	bool "EVB-AST2700"
	depends on ASPEED_AST2700
	select ARCH_MISC_INIT
	help
	  EVB-AST2700 is Aspeed evaluation board for AST2700A0 chip.
	  It has 512M of RAM, 32M of SPI flash, two Ethernet ports,
	  4 Serial ports, 4 USB ports, VGA port, PCIe, SD card slot,
	  20 pin JTAG, pinouts for 14 I2Cs, 3 SPIs and eSPI, 8 PWMs.

config TARGET_AST2700_DCSCM
	bool "AST2700-DCSCM"
	depends on ASPEED_AST2700
	select ARCH_MISC_INIT
	help
	  AST2700_DCSCM is an Aspeed demo board in DCSCM form factor.

endchoice

source "board/aspeed/evb_ast2700/Kconfig"
source "board/aspeed/ast2700_dcscm/Kconfig"

endif
```

## arch/riscv/cpu/ibex/Kconfig
```kconfig
config RISCV_IBEX
	bool
	imply CPU
	imply CPU_RISCV
	help
	  Run U-Boot on IBex RISC-V platform.
```

## board/aspeed/ast2700_dcscm/Kconfig
```kconfig
if TARGET_AST2700_DCSCM

config SYS_BOARD
	default "ast2700_dcscm"

config SYS_VENDOR
	default "aspeed"

config SYS_CONFIG_NAME
	string "board configuration name"
	default "ast2700_dcscm"

config AVENUE_CITY_CRB
	bool "Support for Intel Avenue City CRB"
	default n

endif
```

## board/aspeed/bmcu_ast2700/Kconfig
```kconfig
if TARGET_ASPEED_AST2700BMCU

config SYS_BOARD
	default "bmcu_ast2700"

config SYS_VENDOR
	default "aspeed"

config SYS_CPU
	default "ibex"

config SYS_CONFIG_NAME
	default "bmcu_ast2700"

config BOARD_SPECIFIC_OPTIONS # dummy
	def_bool y
	select RISCV_IBEX
	select SUPPORT_SPL
	imply SPL_DRIVERS_MISC

endif
```

## board/aspeed/ibex_ast2700/Kconfig
```kconfig
if TARGET_ASPEED_AST2700

config ASPEED_FPGA
	bool "Enable FPGA support"
	help
	  Say Y is platform is FPGA.

config SYS_BOARD
	default "ibex_ast2700"

config SYS_VENDOR
	default "aspeed"

config SYS_CPU
	default "ast2700"

config SYS_CONFIG_NAME
	default "ibex_ast2700"

config BOARD_SPECIFIC_OPTIONS
	def_bool y
	select RISCV_AST2700
	select SUPPORT_SPL
	select BINMAN
	imply SPL_DRIVERS_MISC

config SPI_ASPEED_DMA
	bool "Enable ASPEED SPI DMA"
	default n

config ASPEED_PHY_TRAINING_MESSAGE
	bool "Enable DDR PHY TRAINING MESSAGE"
	default n

config ASPEED_DRAM_ECC
	bool "Enable dramc ECC"
	default n

config ASPEED_DRAM_AES
	bool "Enable dramc AES"
	default n

choice
	prompt "AST2700 DDR target date rate"
	default ASPEED_DDR_3200
	depends on ASPEED_RAM
	depends on TARGET_ASPEED_AST2700

config ASPEED_DDR_1600
	bool "1600Mbps"
	help
	  select DDR4 target data rate at 1600M

config ASPEED_DDR_2400
	bool "2400Mbps"
	help
	  select DDR4 target data rate at 2400M

config ASPEED_DDR_3200
	bool "3200Mbps"
	help
	  select DDR4 target data rate at 3200M

endchoice

choice
	prompt "AST2700 MPLL frequency"
	default ASPEED_MPLL_1600

config ASPEED_MPLL_800
	bool "800MHz"
	help
	  set mpll default speed at 800Mhz

config ASPEED_MPLL_1000
	bool "1000MHz"
	help
	  set mpll default speed at 1000Mhz

config ASPEED_MPLL_1200
	bool "1200MHz"
	help
	  set mpll default speed at 1200Mhz

config ASPEED_MPLL_1400
	bool "1400MHz"
	help
	  set mpll default speed at 1400Mhz

config ASPEED_MPLL_1600
	bool "1600MHz"
	help
	  set mpll default speed at 1600Mhz

endchoice

endif
```

## cmd/aspeed/Kconfig
```kconfig
config CMD_OTP
	bool "Support OTP utility"
	select AST2600_CMD_OTP if ASPEED_AST2600
	select AST2700_CMD_OTP if ASPEED_AST2700
	default y
	help
	  Enable otp cmd support for Aspeed OTP hardware engine.

config AST2600_CMD_OTP
	bool "Support AST2600 OTP utility"
	depends on CMD_OTP
	depends on SHA256 && SHA384 && SHA512
	help
	  Enable cmd support for Aspeed AST2600 OTP utility.
	  AST2600 OTP utility provides read/program data/conf/strap
	  OTP regions and multiple subcommands supported.

config AST2700_CMD_OTP
	bool "Support AST2700 OTP utility"
	depends on CMD_OTP
	select ASPEED_OTP
	help
	  Enable cmd support for Aspeed AST2700 OTP utility.
	  AST2700 OTP utility provides read/program multiple
	  OTP regions.
	  It also needs Aspeed OTP driver model to support it.

config AST2700_CMD_FLASH_STRAP
	bool "ASPEED Flash Strap"
	depends on DM_SPI_FLASH || SPI_FLASH
	default n
	help
	  Enable AST2700 flash strap operation.
```

## configs/bmcu-ast2700_defconfig
```kconfig
CONFIG_RISCV=y
CONFIG_SYS_DCACHE_OFF=y
# CONFIG_SPL_USE_ARCH_MEMCPY is not set
# CONFIG_SPL_USE_ARCH_MEMMOVE is not set
# CONFIG_SPL_USE_ARCH_MEMSET is not set
CONFIG_TEXT_BASE=0x80000000
CONFIG_SYS_MALLOC_LEN=0x700
CONFIG_SYS_MALLOC_F_LEN=0x700
CONFIG_NR_DRAM_BANKS=1
CONFIG_SPL_LDSCRIPT="arch/$(ARCH)/cpu/ibex/u-boot-spl.lds"
CONFIG_HAS_CUSTOM_SYS_INIT_SP_ADDR=y
CONFIG_CUSTOM_SYS_INIT_SP_ADDR=0x14bd7800
CONFIG_ENV_SIZE=0x20000
CONFIG_DEFAULT_DEVICE_TREE="ast2700-bmcu"
CONFIG_SPL_TEXT_BASE=0x14bc0080
CONFIG_DM_RESET=y
CONFIG_SPL_MMC=y
CONFIG_SPL_SIZE_LIMIT=0x16000
CONFIG_SPL=y
CONFIG_DEBUG_UART_BASE=0x14c33b00
CONFIG_DEBUG_UART_CLOCK=1846153
CONFIG_SYS_LOAD_ADDR=0x83000000
CONFIG_DEBUG_UART=y
CONFIG_TARGET_ASPEED_AST2700BMCU=y
# CONFIG_RISCV_ISA_F is not set
# CONFIG_RISCV_ISA_A is not set
# CONFIG_SPL_SMP is not set
CONFIG_XIP=y
CONFIG_SPL_XIP=y
# CONFIG_AVAILABLE_HARTS is not set
CONFIG_STACK_SIZE_SHIFT=12
CONFIG_ENV_VARS_UBOOT_CONFIG=y
# CONFIG_SYS_MALLOC_CLEAR_ON_INIT is not set
CONFIG_FIT=y
CONFIG_FIT_SIGNATURE=y
# CONFIG_FIT_PRINT is not set
CONFIG_SPL_LOAD_FIT=y
CONFIG_SPL_LOAD_FIT_ADDRESS=0x200c0000
CONFIG_SPL_FIT_IMAGE_POST_PROCESS=y
# CONFIG_BOOTSTD is not set
# CONFIG_ARCH_FIXUP_FDT_MEMORY is not set
# CONFIG_CONSOLE_FLUSH_SUPPORT is not set
# CONFIG_CONSOLE_MUX is not set
CONFIG_SYS_STDIO_DEREGISTER=y
CONFIG_BOARD_LATE_INIT=y
CONFIG_SPL_MAX_SIZE=0x16000
CONFIG_SPL_BSS_START_ADDR=0x14bd7800
CONFIG_SPL_BSS_MAX_SIZE=0x800
CONFIG_SPL_SHOW_ERRORS=y
# CONFIG_SPL_RAW_IMAGE_SUPPORT is not set
CONFIG_SYS_MMCSD_RAW_MODE_U_BOOT_USE_SECTOR=y
CONFIG_SYS_MMCSD_RAW_MODE_U_BOOT_SECTOR=0x600
CONFIG_SPL_MMC_TINY=y
CONFIG_SPL_XIP_SUPPORT=y
CONFIG_SPL_DM_RESET=y
CONFIG_SPL_RAM_SUPPORT=y
CONFIG_SPL_RAM_DEVICE=y
CONFIG_SPL_WATCHDOG=y
# CONFIG_CMDLINE is not set
CONFIG_SYS_CBSIZE=256
CONFIG_SYS_PBSIZE=276
# CONFIG_CMD_BOOTD is not set
# CONFIG_CMD_BOOTI is not set
# CONFIG_BOOTM_LINUX is not set
# CONFIG_BOOTM_NETBSD is not set
# CONFIG_BOOTM_PLAN9 is not set
# CONFIG_BOOTM_RTEMS is not set
# CONFIG_BOOTM_VXWORKS is not set
CONFIG_SYS_BOOTM_LEN=0x4000000
# CONFIG_CMD_ELF is not set
# CONFIG_CMD_FDT is not set
# CONFIG_CMD_IMI is not set
# CONFIG_CMD_XIMG is not set
# CONFIG_CMD_SAVEENV is not set
# CONFIG_CMD_CRC32 is not set
# CONFIG_CMD_LOADB is not set
# CONFIG_CMD_LOADS is not set
# CONFIG_CMD_VIRTIO is not set
CONFIG_CMD_SYSBOOT=y
# CONFIG_CMD_VIDCONSOLE is not set
# CONFIG_CMD_OTP is not set
CONFIG_CMD_EXT4=y
CONFIG_CMD_FS_GENERIC=y
CONFIG_DEVICE_TREE_INCLUDES="ast2700-u-boot.dtsi"
# CONFIG_OF_TAG_MIGRATE is not set
CONFIG_SYS_RELOC_GD_ENV_ADDR=y
# CONFIG_NET is not set
CONFIG_SYS_RX_ETH_BUFFER=2
# CONFIG_DM_WARN is not set
# CONFIG_DM_DEVICE_REMOVE is not set
# CONFIG_DM_SEQ_ALIAS is not set
CONFIG_REGMAP=y
CONFIG_SPL_REGMAP=y
CONFIG_SYSCON=y
CONFIG_SPL_SYSCON=y
CONFIG_SPL_OF_TRANSLATE=y
# CONFIG_BLOCK_CACHE is not set
CONFIG_SPL_CLK=y
CONFIG_CLK_AST2700=y
# CONFIG_CPU is not set
# CONFIG_GPIO is not set
# CONFIG_I2C is not set
CONFIG_SPL_ASPEED_DP=y
CONFIG_MMC=y
CONFIG_SUPPORT_EMMC_BOOT=y
CONFIG_MMC_SDHCI=y
CONFIG_MMC_SDHCI_ASPEED=y
# CONFIG_MTD is not set
CONFIG_USE_SYS_MAX_FLASH_BANKS=y
CONFIG_SYS_MAX_FLASH_BANKS=2
# CONFIG_POWER is not set
CONFIG_RAM=y
CONFIG_SPL_RAM=y
CONFIG_ASPEED_RAM=y
CONFIG_ASPEED_FPGA=y
CONFIG_ASPEED_DDR_PHY_TRAINING=y
# CONFIG_RAM_SIFIVE is not set
CONFIG_RESET_AST2700=y
CONFIG_DEBUG_UART_SHIFT=2
CONFIG_SYS_NS16550=y
CONFIG_SYS_NS16550_MEM32=y
# CONFIG_TIMER is not set
CONFIG_VIDEO=y
# CONFIG_VIDEO_LOGO is not set
CONFIG_VIDEO_ANSI=y
CONFIG_SYS_WHITE_ON_BLACK=y
CONFIG_VIDEO_BMP_RLE8=y
CONFIG_VIRTIO_MMIO=y
CONFIG_VIRTIO_NET=y
CONFIG_VIRTIO_BLK=y
# CONFIG_SPL_WDT is not set
CONFIG_SPL_TINY_MEMSET=y
# CONFIG_RSA is not set
# CONFIG_SPL_SHA1 is not set
# CONFIG_SPL_SHA256 is not set
# CONFIG_EFI_LOADER is not set
```

## configs/evb-ast2600_defconfig
```kconfig
CONFIG_ARM=y
CONFIG_SYS_DCACHE_OFF=y
CONFIG_POSITION_INDEPENDENT=y
CONFIG_SPL_SYS_THUMB_BUILD=y
CONFIG_ARCH_ASPEED=y
CONFIG_TEXT_BASE=0x10000
CONFIG_SYS_MALLOC_LEN=0x2000000
CONFIG_SYS_MALLOC_F_LEN=0x800
CONFIG_ASPEED_AST2600=y
CONFIG_TARGET_EVB_AST2600=y
CONFIG_SPL_LIBCOMMON_SUPPORT=y
CONFIG_SPL_LIBGENERIC_SUPPORT=y
CONFIG_NR_DRAM_BANKS=1
CONFIG_SPL_LDSCRIPT="arch/arm/mach-aspeed/ast2600/u-boot-spl.lds"
CONFIG_ENV_SIZE=0x20000
CONFIG_ENV_OFFSET=0x140000
CONFIG_ENV_SECT_SIZE=0x20000
CONFIG_DM_GPIO=y
CONFIG_DEFAULT_DEVICE_TREE="ast2600-evb"
CONFIG_DM_RESET=y
CONFIG_SPL_SERIAL=y
CONFIG_SPL_DRIVERS_MISC=y
CONFIG_SPL_STACK_R_ADDR=0x93000000
CONFIG_SPL_SIZE_LIMIT=0x10000
CONFIG_SPL=y
# CONFIG_ARMV7_NONSEC is not set
CONFIG_SYS_LOAD_ADDR=0x83000000
CONFIG_PCI=y
CONFIG_PCIE_ASPEED=y
# CONFIG_SYS_MALLOC_CLEAR_ON_INIT is not set
CONFIG_FIT=y
CONFIG_SPL_FIT_SIGNATURE=y
CONFIG_SPL_LOAD_FIT=y
CONFIG_SPL_LOAD_FIT_ADDRESS=0x10000
CONFIG_SPL_FIT_IMAGE_POST_PROCESS=y
CONFIG_USE_BOOTARGS=y
CONFIG_BOOTARGS="console=ttyS4,115200n8 root=/dev/ram rw"
CONFIG_USE_BOOTCOMMAND=y
CONFIG_BOOTCOMMAND="echo Boot from ${boot_device}; if test ${boot_device} = mmc; then run bootmmc; fi; if test ${boot_device} = spi; then run bootspi; fi;"
CONFIG_DISPLAY_BOARDINFO_LATE=y
CONFIG_SPL_SIZE_LIMIT_SUBTRACT_GD=y
CONFIG_SPL_SIZE_LIMIT_SUBTRACT_MALLOC=y
CONFIG_SPL_HAS_BSS_LINKER_SECTION=y
CONFIG_SPL_BSS_START_ADDR=0x83000000
CONFIG_SPL_BSS_MAX_SIZE=0x1000000
CONFIG_SPL_SYS_MALLOC_SIMPLE=y
CONFIG_SPL_STACK_R=y
CONFIG_SPL_SEPARATE_BSS=y
CONFIG_SYS_MMCSD_RAW_MODE_U_BOOT_USE_SECTOR=y
CONFIG_SYS_MMCSD_RAW_MODE_U_BOOT_SECTOR=0x80
CONFIG_SPL_DM_RESET=y
CONFIG_SPL_RAM_SUPPORT=y
CONFIG_SPL_RAM_DEVICE=y
CONFIG_SPL_WATCHDOG=y
CONFIG_SPL_OPTEE_IMAGE=y
CONFIG_HUSH_PARSER=y
CONFIG_SYS_PROMPT="ast# "
CONFIG_SYS_CBSIZE=256
CONFIG_SYS_PBSIZE=276
CONFIG_CMD_BOOTZ=y
# CONFIG_BOOTM_NETBSD is not set
# CONFIG_BOOTM_PLAN9 is not set
# CONFIG_BOOTM_RTEMS is not set
# CONFIG_BOOTM_VXWORKS is not set
# CONFIG_CMD_IMI is not set
# CONFIG_CMD_XIMG is not set
CONFIG_CMD_EEPROM=y
CONFIG_CMD_MEMTEST=y
CONFIG_SYS_ALT_MEMTEST=y
CONFIG_CMD_CLK=y
CONFIG_CMD_GPIO=y
CONFIG_CMD_PWM=y
CONFIG_CMD_I2C=y
CONFIG_CMD_MMC=y
CONFIG_CMD_PART=y
CONFIG_CMD_PCI=y
CONFIG_CMD_SF_TEST=y
CONFIG_CMD_USB=y
CONFIG_CMD_DHCP=y
CONFIG_BOOTP_BOOTFILESIZE=y
CONFIG_CMD_MII=y
CONFIG_CMD_PING=y
CONFIG_CMD_NCSI=y
CONFIG_CMD_EXT2=y
CONFIG_CMD_EXT4=y
CONFIG_CMD_EXT4_WRITE=y
CONFIG_CMD_FAT=y
CONFIG_CMD_FS_GENERIC=y
# CONFIG_SPL_DOS_PARTITION is not set
CONFIG_EFI_PARTITION=y
# CONFIG_SPL_EFI_PARTITION is not set
CONFIG_SPL_OF_CONTROL=y
CONFIG_ENV_OVERWRITE=y
CONFIG_ENV_IS_IN_MMC=y
CONFIG_ENV_IS_IN_SPI_FLASH=y
CONFIG_ENV_SECT_SIZE_AUTO=y
CONFIG_ENV_SPI_MAX_HZ=100000000
CONFIG_SYS_RELOC_GD_ENV_ADDR=y
CONFIG_NET_RANDOM_ETHADDR=y
CONFIG_SPL_DM=y
CONFIG_SPL_DM_SEQ_ALIAS=y
CONFIG_REGMAP=y
CONFIG_SPL_OF_TRANSLATE=y
CONFIG_CLK=y
CONFIG_SPL_CLK=y
CONFIG_DM_HASH=y
CONFIG_ASPEED_ACRY=y
CONFIG_ASPEED_HACE=y
CONFIG_SPI_ASPEED_DMA=y
CONFIG_ASPEED_GPIO=y
CONFIG_DM_I2C=y
CONFIG_SYS_I2C_ASPEED=y
CONFIG_ASPEED_AHBC=y
CONFIG_ASPEED_DP=y
CONFIG_I2C_EEPROM=y
CONFIG_MMC_SDHCI=y
CONFIG_MMC_SDHCI_ASPEED=y
CONFIG_DM_SPI_FLASH=y
CONFIG_SPI_FLASH_SFDP_SUPPORT=y
CONFIG_SPI_FLASH_GIGADEVICE=y
CONFIG_SPI_FLASH_ISSI=y
CONFIG_SPI_FLASH_MACRONIX=y
CONFIG_SPI_FLASH_SPANSION=y
CONFIG_SPI_FLASH_STMICRO=y
CONFIG_SPI_FLASH_SST=y
CONFIG_SPI_FLASH_WINBOND=y
CONFIG_SPI_FLASH_XMC=y
# CONFIG_SPI_FLASH_USE_4K_SECTORS is not set
CONFIG_PHY_BROADCOM=y
CONFIG_PHY_REALTEK=y
CONFIG_PHY_NCSI=y
CONFIG_DM_MDIO=y
CONFIG_PHY_GIGE=y
CONFIG_FTGMAC100=y
CONFIG_ASPEED_MDIO=y
CONFIG_PHY=y
CONFIG_PINCTRL=y
CONFIG_DM_PWM=y
CONFIG_PWM_ASPEED=y
CONFIG_RAM=y
CONFIG_SPL_RAM=y
CONFIG_ASPEED_RAM=y
CONFIG_DM_SERIAL=y
CONFIG_SYS_NS16550=y
CONFIG_SPI=y
CONFIG_DM_SPI=y
CONFIG_SPI_DIRMAP=y
CONFIG_SPI_ASPEED_SMC=y
CONFIG_SYSRESET=y
CONFIG_SPL_SYSRESET=y
CONFIG_TEE=y
CONFIG_USB=y
CONFIG_USB_EHCI_HCD=y
CONFIG_USB_STORAGE=y
# CONFIG_WATCHDOG_AUTOSTART is not set
CONFIG_WDT=y
# CONFIG_WDT_ASPEED is not set
# CONFIG_SPL_WDT is not set
CONFIG_SPL_TINY_MEMSET=y
CONFIG_SHA384=y
CONFIG_SPL_CRC32=y
CONFIG_HEXDUMP=y
# CONFIG_EFI_LOADER is not set
CONFIG_PHANDLE_CHECK_SEQ=y
```

## configs/fpga-ast2700_defconfig
```kconfig
CONFIG_ARM=y
CONFIG_SKIP_LOWLEVEL_INIT=y
CONFIG_COUNTER_FREQUENCY=24000000
CONFIG_POSITION_INDEPENDENT=y
# CONFIG_INIT_SP_RELATIVE is not set
CONFIG_ARM_SMCCC=y
CONFIG_ARCH_ASPEED=y
CONFIG_SYS_TEXT_BASE=0x400840000
CONFIG_SYS_MALLOC_LEN=0x2000000
CONFIG_ASPEED_AST2700=y
CONFIG_SPL_LIBCOMMON_SUPPORT=y
CONFIG_SPL_LIBGENERIC_SUPPORT=y
CONFIG_NR_DRAM_BANKS=1
CONFIG_ENV_SIZE=0x1000
CONFIG_ENV_OFFSET=0x7f000
CONFIG_ENV_SECT_SIZE=0x1000
CONFIG_DM_GPIO=y
CONFIG_DEFAULT_DEVICE_TREE="ast2700-fpga"
CONFIG_SPL_TEXT_BASE=0x400800000
CONFIG_SPL_SERIAL=y
CONFIG_SPL=y
CONFIG_DEBUG_UART_BASE=0x14c33b00
CONFIG_DEBUG_UART_CLOCK=1846154
# CONFIG_PSCI_RESET is not set
CONFIG_IMX_DCD_ADDR=0x0
CONFIG_SYS_LOAD_ADDR=0x404000000
CONFIG_ENV_ADDR=0x7f000
CONFIG_DEBUG_UART=y
CONFIG_HAS_CUSTOM_SYS_INIT_SP_ADDR=y
CONFIG_CUSTOM_SYS_INIT_SP_ADDR=0x404000000
# CONFIG_SYS_MALLOC_CLEAR_ON_INIT is not set
CONFIG_FIT=y
CONFIG_SPL_FIT_SIGNATURE=y
CONFIG_SPL_LOAD_FIT=y
CONFIG_SPL_LOAD_FIT_ADDRESS=0x1000a0000
# CONFIG_USE_SPL_FIT_GENERATOR is not set
CONFIG_LEGACY_IMAGE_FORMAT=y
CONFIG_USE_BOOTARGS=y
CONFIG_BOOTARGS="console=ttyS12,115200n8 root=/dev/ram rw earlycon"
CONFIG_USE_BOOTCOMMAND=y
CONFIG_BOOTCOMMAND="run bootspi"
CONFIG_DISPLAY_BOARDINFO_LATE=y
CONFIG_SPL_MAX_SIZE=0x20000
CONFIG_SPL_PAD_TO=0x0
CONFIG_SPL_HAS_BSS_LINKER_SECTION=y
CONFIG_SPL_BSS_START_ADDR=0x400820000
CONFIG_SPL_BSS_MAX_SIZE=0x20000
CONFIG_SPL_RAM_SUPPORT=y
CONFIG_SPL_RAM_DEVICE=y
CONFIG_SPL_ATF=y
CONFIG_SPL_ATF_LOAD_IMAGE_V2=y
CONFIG_HUSH_PARSER=y
# CONFIG_AUTO_COMPLETE is not set
CONFIG_SYS_CBSIZE=256
CONFIG_SYS_PBSIZE=276
CONFIG_CMD_BOOTZ=y
# CONFIG_BOOTM_NETBSD is not set
# CONFIG_BOOTM_PLAN9 is not set
# CONFIG_BOOTM_RTEMS is not set
# CONFIG_BOOTM_VXWORKS is not set
# CONFIG_CMD_IMI is not set
# CONFIG_CMD_XIMG is not set
CONFIG_CMD_EEPROM=y
CONFIG_CMD_CLK=y
CONFIG_CMD_GPIO=y
CONFIG_CMD_I2C=y
CONFIG_CMD_MMC=y
CONFIG_CMD_SF_TEST=y
# CONFIG_CMD_BOOTP is not set
CONFIG_CMD_MII=y
CONFIG_CMD_PING=y
CONFIG_CMD_CACHE=y
CONFIG_CMD_EXT4=y
CONFIG_DOS_PARTITION=y
CONFIG_EFI_PARTITION=y
CONFIG_SPL_OF_CONTROL=y
CONFIG_ENV_OVERWRITE=y
CONFIG_ENV_IS_IN_SPI_FLASH=y
CONFIG_ENV_SECT_SIZE_AUTO=y
CONFIG_SYS_RELOC_GD_ENV_ADDR=y
CONFIG_NET_RANDOM_ETHADDR=y
CONFIG_SPL_DM=y
CONFIG_REGMAP=y
CONFIG_SYSCON=y
CONFIG_SPL_OF_TRANSLATE=y
CONFIG_CLK=y
CONFIG_ASPEED_GPIO=y
CONFIG_DM_I2C=y
CONFIG_SYS_I2C_AST2600=y
# CONFIG_INPUT is not set
CONFIG_I2C_EEPROM=y
CONFIG_MMC_SDHCI=y
CONFIG_MMC_SDHCI_ASPEED=y
CONFIG_DM_SPI_FLASH=y
CONFIG_SPI_FLASH_MACRONIX=y
CONFIG_SPI_FLASH_SPANSION=y
CONFIG_SPI_FLASH_WINBOND=y
CONFIG_PHY_BROADCOM=y
CONFIG_PHY_REALTEK=y
CONFIG_DM_MDIO=y
CONFIG_FTGMAC100=y
CONFIG_ASPEED_MDIO=y
CONFIG_PHY=y
CONFIG_PINCTRL=y
# CONFIG_POWER is not set
CONFIG_RAM=y
CONFIG_SPL_RAM=y
CONFIG_DM_RESET=y
CONFIG_DM_SERIAL=y
CONFIG_DEBUG_UART_SHIFT=2
CONFIG_SYS_NS16550=y
CONFIG_SPI=y
CONFIG_DM_SPI=y
CONFIG_SPI_ASPEED_SMC=y
CONFIG_SYSRESET=y
CONFIG_SPL_SYSRESET=y
# CONFIG_WATCHDOG_AUTOSTART is not set
CONFIG_WDT=y
# CONFIG_WDT_ASPEED is not set
CONFIG_WDT_AST2600=y
# CONFIG_RSA is not set
```

## drivers/clk/aspeed/Kconfig
```kconfig
config CLK_AST2700
	bool "Clock support for AST2700"
	select CLK
	help
	  This enables DM/DTS support for clock driver in AST2700 platforms.
```
