## drivers/phy/aspeed/Kconfig
```kconfig
# SPDX-License-Identifier: GPL-2.0-only
#
# Phy drivers for Aspeed platforms
#

config PHY_ASPEED_PCIE
	tristate "ASPEED PCIe PHY driver"
	depends on PHY
	depends on ARCH_ASPEED
	help
	  This option enables support for the ASPEED PCIe PHY driver.
	  The driver provides the necessary interface to control and
	  configure the PCIe PHY hardware found on ASPEED SoCs.
	  It is required for proper operation of PCIe devices on
	  platforms using ASPEED chips.

config PHY_ASPEED_SGMII
	tristate "ASPEED SGMII PHY driver"
	depends on PHY
	depends on SYSCON
	depends on ASPEED_AST2700
	default n
	help
	  Enable driver support for Aspeed AST2700 PHY SGMII.
```

## lib/aspeed/Kconfig
```kconfig
config ASPEED_FMC_HEADER
	bool "Enable ASPEED FMC header lib"
	help
	  Support ASPEED proprietary boot FMC header lib

config ASPEED_CPTRA
	bool "Use Caliptra Library"
        help
          This enables the Caliptra common library to communicate with BootMCU
          via IPC in AST27xx SoC series.
```
